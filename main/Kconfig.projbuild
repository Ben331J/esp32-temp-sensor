## main/Kconfig.projbuild
```kconfig
menu "WiFi Configuration"

    config WIFI_SSID
        string "WiFi SSID"
        default "myssid"
        help
            SSID (network name) to connect to.

    config WIFI_PASSWORD
        string "WiFi Password"
        default "mypassword"
        help
            WiFi password (WPA or WPA2) to use.

    config MAXIMUM_RETRY
        int "Maximum retry"
        default 5
        help
            Set the Maximum retry to avoid station reconnecting to the AP unlimited when the AP is really inexistent.

    config STATIC_IP_ADDR
        string "Static IP address"
        default "192.168.4.2"
        help
            Set static IP address.

    config STATIC_NETMASK_ADDR
        string "Static netmask address"
        default "255.255.255.0"
        help
            Set static netmask address.

    config STATIC_GW_ADDR
        string "Static gateway address"
        default "192.168.4.1"
        help
            Set static gateway address.

    choice STATIC_DNS_SERVER
        prompt "Choose DNS server"
        default STATIC_DNS_AUTO
        help
            Select auto to make gateway address as DNS server or manual to input your DNS server
        config STATIC_DNS_AUTO
            bool "Use gateway address as DNS server"
            help
                Set DNS server the same as gateway address

        config STATIC_DNS_MANUAL
            bool "Set manual value as DNS server"
            help
                Set DNS server with you want
    endchoice

    config STATIC_DNS_SERVER_MAIN
        string "Main DNS server address"
        default "192.168.4.1"
        depends on STATIC_DNS_MANUAL
        help
            Set main DNS server address.

    config STATIC_DNS_SERVER_BACKUP
        string "Backup DNS server address"
        default "192.168.4.1"
        depends on STATIC_DNS_MANUAL
        help
            Set backup DNS server address. It can be same with the main DNS server address or leave empty.

    config STATIC_DNS_RESOLVE_TEST
        bool "Enable DNS resolve test"
        default n
        help
            Enable it and configure STATIC_RESOLVE_DOMAIN to resolve DNS domain name

    config STATIC_RESOLVE_DOMAIN
        string "Domain name to resolve"
        default "www.espressif.com"
        depends on STATIC_DNS_RESOLVE_TEST
        help
            Set domain name for DNS test
endmenu
```
